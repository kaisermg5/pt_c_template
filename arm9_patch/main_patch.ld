OUTPUT_ARCH(arm)
MEMORY {
  
}

arm9_extension_start = 0x02380000; 		/* Should also be modified in arm9_extension.ld */
arm9_extension_size = 512 * 1024;			/* Should also be modified in arm9_extension.ld */

SECTIONS {

}
